## meta-rockchip/conf/machine/tinker-board-s.conf
```bitbake
# Copyright (C) 2020  Sergey Bostandzhyan
# Released under the MIT license (see COPYING.MIT for the terms)

#@TYPE: Machine
#@NAME: Tinker-S RK3288
#@DESCRIPTION: ASUS Tinker Board is a Raspberry Pi 3 Alternative based on Rockchip RK3288 Processor.

require conf/machine/include/rk3288.inc

KERNEL_DEVICETREE = "rk3288-tinker-s.dtb"
UBOOT_MACHINE = "tinker-s-rk3288_defconfig"

RK_BOOT_DEVICE ?= "mmcblk1"

WKS_FILE ?= "tinker-board.wks"
IMAGE_FSTYPES += "wic wic.bmap"

WKS_FILE_DEPENDS ?= " \
    mtools-native \
    dosfstools-native \
    virtual/bootloader \
    virtual/kernel \
    "
IMAGE_BOOT_FILES ?= "\
    ${KERNEL_IMAGETYPE} \
    ${KERNEL_DEVICETREE} \
    "
```

## meta-rockchip/conf/machine/tinker-board.conf
```bitbake
# Copyright (C) 2018  Trevor Woerner
# Released under the MIT license (see COPYING.MIT for the terms)

#@TYPE: Machine
#@NAME: Tinker RK3288
#@DESCRIPTION: ASUS Tinker Board is a Raspberry Pi 3 Alternative based on Rockchip RK3288 Processor.

require conf/machine/include/rk3288.inc

KERNEL_DEVICETREE = "rk3288-tinker.dtb"
UBOOT_MACHINE = "tinker-rk3288_defconfig"

WKS_FILE ?= "tinker-board.wks"
IMAGE_FSTYPES += "wic wic.bmap"

WKS_FILE_DEPENDS ?= " \
    mtools-native \
    dosfstools-native \
    virtual/bootloader \
    virtual/kernel \
    "
IMAGE_BOOT_FILES ?= "\
    ${KERNEL_IMAGETYPE} \
    ${KERNEL_DEVICETREE} \
    "
```

## meta-rockchip/conf/machine/vyasa-rk3288.conf
```bitbake
# Copyright (C) 2018 Amarula Solutions
# Released under the MIT license (see COPYING.MIT for the terms)

#@TYPE: Machine
#@NAME: Amarula Vyasa RK3288
#@DESCRIPTION: Amarula Vyasa is Rockchip RK3288 SOC based Single board computer with fully supported opensource software.

require conf/machine/include/rk3288.inc

KERNEL_IMAGETYPE = "uImage"
KERNEL_DEVICETREE = "rk3288-vyasa.dtb"
KERNEL_EXTRA_ARGS += "LOADADDR=0x02000000"

UBOOT_MACHINE = "vyasa-rk3288_defconfig"

RK_BOOT_DEVICE = "mmcblk2"
WKS_FILE ?= "vyasa-rk3288.wks"
IMAGE_FSTYPES += "wic wic.bmap"

WKS_FILE_DEPENDS ?= " \
    mtools-native \
    dosfstools-native \
    virtual/bootloader \
    virtual/kernel \
    "
IMAGE_BOOT_FILES ?= "\
    ${KERNEL_IMAGETYPE} \
    ${KERNEL_DEVICETREE} \
    "
```

## meta-rockchip/wic/tinker-board.wks
```
# Copyright (C) 2019 Garmin Ltd. or its subsidiaries
# Released under the MIT license (see COPYING.MIT for the terms)

include rk3288-boot.wks

part / --align 131072 --ondisk ${RK_BOOT_DEVICE} --source rootfs --fstype=ext4 --label root

bootloader --ptable gpt --append="console=tty1 console=ttyS2,115200n8 rw root=/dev/${RK_BOOT_DEVICE}p7 rootfstype=ext4 init=/sbin/init"
```

## meta-systemdev/conf/distro/systemdev.conf
```bitbake
DISTRO = "systemdev"
DISTRO_NAME = "Systemdev"
DISTRO_VERSION = "0.1+snapshot-${DATE}"
DISTRO_CODENAME = "systemdev"
SDK_VENDOR = "-systemdevsdk"
SDK_VERSION := "${@'${DISTRO_VERSION}'.replace('snapshot-${DATE}','snapshot')}"

MAINTAINER = "Darren Hart <dvhart@linux.intel.com>"

TARGET_VENDOR = "-systemdev"

LOCALCONF_VERSION = "1"
LAYER_CONF_VERSION ?= "6"

# Override these in Systemdev based distros
SYSTEMDEV_DEFAULT_DISTRO_FEATURES = "largefile x11 opengl ptest multiarch"
SYSTEMDEV_DEFAULT_EXTRA_RDEPENDS = "packagegroup-core-boot"
SYSTEMDEV_DEFAULT_EXTRA_RRECOMMENDS = "kernel-module-af-packet"

DISTRO_FEATURES_append = " systemd pam wayland"
VIRTUAL-RUNTIME_init_manager = "systemd"
DISTRO_FEATURES_BACKFILL_CONSIDERED = "sysvinit"
VIRTUAL-RUNTIME_initscripts = ""
VIRTUAL-RUNTIME_xserver_common = "xserver-common"

DISTRO_FEATURES ?= "${DISTRO_FEATURES_DEFAULT} ${DISTRO_FEATURES_LIBC} ${SYSTEMDEV_DEFAULT_DISTRO_FEATURES}"

# Prefer systemdev but accept poky overrides. This gets us the meta-yocto yocto
# project psplash, for example.
DISTROOVERRIDES = "systemdev:poky"

EFI_PROVIDER = "gummiboot"

PREFERRED_PROVIDER_jpeg = "libjpeg-turbo"
PREFERRED_PROVIDER_jpeg-native = "libjpeg-turbo-native"

#We include libxvmc in all xfce images allowing us to enable this feature
#in other packages.
PACKAGECONFIG_append_pn-mesa = " xvmc"
#After making the above change we see:
#  QA Issue: xf86-video-intel rdepends on xcb-util, but it isn't a
#  build dependency?
DEPENDS_xf86-video-intel_append = " xcb-util"

SDK_NAME = "${DISTRO}-${TCLIBC}-${SDK_ARCH}-${IMAGE_BASENAME}-${TUNE_PKGARCH}"
SDKPATH = "/opt/${DISTRO}/${SDK_VERSION}"

DISTRO_EXTRA_RDEPENDS += " ${SYSTEMDEV_DEFAULT_EXTRA_RDEPENDS}"
DISTRO_EXTRA_RRECOMMENDS += " ${SYSTEMDEV_DEFAULT_EXTRA_RRECOMMENDS}"

SYSTEMDEVQEMUDEPS = "${@base_contains("INCOMPATIBLE_LICENSE", "GPLv3", "", "qemu-config",d)}"
DISTRO_EXTRA_RDEPENDS_append_qemux86 = " ${SYSTEMDEVQEMUDEPS}"
DISTRO_EXTRA_RDEPENDS_append_qemux86-64 = " ${SYSTEMDEVQEMUDEPS}"

TCLIBCAPPEND = ""

QEMU_TARGETS ?= "i386 x86_64"

PREMIRRORS ??= "\
bzr://.*/.*   http://downloads.yoctoproject.org/mirror/sources/ \n \
cvs://.*/.*   http://downloads.yoctoproject.org/mirror/sources/ \n \
git://.*/.*   http://downloads.yoctoproject.org/mirror/sources/ \n \
hg://.*/.*    http://downloads.yoctoproject.org/mirror/sources/ \n \
osc://.*/.*   http://downloads.yoctoproject.org/mirror/sources/ \n \
p4://.*/.*    http://downloads.yoctoproject.org/mirror/sources/ \n \
svn://.*/.*   http://downloads.yoctoproject.org/mirror/sources/ \n"

MIRRORS =+ "\
ftp://.*/.*      http://downloads.yoctoproject.org/mirror/sources/ \n \
http://.*/.*     http://downloads.yoctoproject.org/mirror/sources/ \n \
https://.*/.*    http://downloads.yoctoproject.org/mirror/sources/ \n"

# The CONNECTIVITY_CHECK_URI's are used to test whether we can succesfully
# fetch from the network (and warn you if not). To disable the test set
# the variable to be empty.
# Git example url: git://git.yoctoproject.org/yocto-firewall-test;protocol=git;rev=HEAD

CONNECTIVITY_CHECK_URIS ?= " \
             https://eula-downloads.yoctoproject.org/index.php \
             http://bugzilla.yoctoproject.org/report.cgi"

SANITY_TESTED_DISTROS ?= " \
            Poky-1.4 \n \
            Poky-1.5 \n \
            Ubuntu-12.04 \n \
            Ubuntu-12.10 \n \
            Ubuntu-13.04 \n \
            Ubuntu-13.10 \n \
            Fedora-18 \n \
            Fedora-19 \n \
            Fedora-20 \n \
            Fedora-21 \n \
            CentOS-6.4 \n \
            CentOS-6.5 \n \
            Debian-7.0 \n \
            Debian-7.1 \n \
            Debian-7.2 \n \
            Debian-7.3 \n \
            Debian-7.4 \n \
            SUSE-LINUX-12.2 \n \
            openSUSE-project-12.3 \n \
            "

# Default hash policy for distro
BB_SIGNATURE_HANDLER ?= 'OEBasicHash'
#
# OELAYOUT_ABI allows us to notify users when the format of TMPDIR changes in 
# an incompatible way. Such changes should usually be detailed in the commit
# that breaks the format and have been previously discussed on the mailing list 
# with general agreement from the core team.
#
OELAYOUT_ABI = "10"

# add poky sanity bbclass from meta-yocto
INHERIT += "poky-sanity"

# QA check settings - a little stricter than the OE-Core defaults
WARN_TO_ERROR_QA = "already-stripped compile-host-path install-host-path \
                     installed-vs-shipped ldflags pn-overrides rpaths \
                     staticdev useless-rpaths"
WARN_QA_remove = "${WARN_TO_ERROR_QA}"
ERROR_QA_append = " ${WARN_TO_ERROR_QA}"
```

## meta-systemdev/conf/layer.conf
```bitbake
# We have a conf and classes directory, add to BBPATH
BBPATH .= ":${LAYERDIR}"

# We have recipes-* directories, add to BBFILES
BBFILES += "${LAYERDIR}/recipes-*/*/*.bb \
	${LAYERDIR}/recipes-*/*/*.bbappend"

BBFILE_COLLECTIONS += "systemdev"
BBFILE_PATTERN_systemdev = "^${LAYERDIR}/"
BBFILE_PRIORITY_systemdev = "6"

LAYERDEPENDS_systemdev = "core openembedded-layer gnome-layer xfce-layer"
LAYERDEPENDS_systemdev += "multimedia-layer networking-layer meta-python"
LAYERDEPENDS_systemdev += "filesystems-layer intel"

LAYERSERIES_COMPAT_systemdev = "zeus dunfell"
```
