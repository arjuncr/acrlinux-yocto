## meta-cloud-services/meta-openstack/conf/layer.conf
```bitbake
# We have a conf and classes directory, append to BBPATH
BBPATH .= ":${LAYERDIR}"

# We have a recipes directory, add to BBFILES
BBFILES += "${LAYERDIR}/recipes*/*/*.bb ${LAYERDIR}/recipes*/*/*.bbappend"

BBFILE_COLLECTIONS += "openstack-layer"
BBFILE_PATTERN_openstack-layer := "^${LAYERDIR}/"
BBFILE_PRIORITY_openstack-layer = "5"
LAYERSERIES_COMPAT_openstack-layer = "zeus dunfell"
BB_DANGLINGAPPENDS_WARNONLY ?= "true"

LAYERDEPENDS_openstack-layer = " \
	core \
        cloud-services-layer \
	openembedded-layer \
	networking-layer \
	filesystems-layer \
	webserver \
	meta-python \
	virtualization-layer \
	"

# pre 0.4.0 greenlet versions segfault python
PREFERRED_VERSION_python-greenlet = "0.4.5"
PREFERRED_VERSION_python-sqlalchemy = "1.0.8"
PREFERRED_VERSION_python-pexpect = "3.3"
PREFERRED_VERSION_python-django = "1.8.6"
PREFERRED_VERSION_python-netaddr = "0.7.19"
PREFERRED_VERSION_python-sqlalchemy = "1.1.17"
PREFERRED_VERSION_python-eventlet = "0.25.1"
PREFERRED_VERSION_python-warlock = "1.3.3"
PREFERRED_VERSION_python-jsonschema = "3.0.2"
PREFERRED_VERSION_python-networkx = "${@bb.utils.contains('DISTRO_FEATURES', 'openstack', '1.11', '', d)}"
PREFERRED_VERSION_python-oslo.i18n = "3.17.0+gitAUTOINC+f2729cd36f"

# Sanity check for meta-openstack layer.
# Setting SKIP_META_OPENSTACK_SANITY_CHECK to "1" would skip the bbappend files check.
INHERIT += "sanity-meta-openstack"

LICENSE_PATH += "${LAYERDIR}/licenses"
```

## meta-openssl102/conf/layer.conf
```bitbake
# We have a conf and classes directory, add to BBPATH
BBPATH =. "${LAYERDIR}:"

BBFILES += "${LAYERDIR}/recipes-*/*/*.bb \
        ${LAYERDIR}/recipes-*/*/*.bbappend"

BBFILE_COLLECTIONS += "meta-openssl-one-zero-two"
BBFILE_PATTERN_meta-openssl-one-zero-two = "^${LAYERDIR}/"
BBFILE_PRIORITY_meta-openssl-one-zero-two = "5"

LAYERVERSION_meta-openssl-one-zero-two = "1"

LAYERSERIES_COMPAT_meta-openssl-one-zero-two = "thud warrior zeus dunfell"

LAYERDEPENDS_meta-openssl-one-zero-two = " \
        core \
"
```

## meta-rockchip/conf/machine/firefly-rk3288.conf
```bitbake
# Copyright (C) 2015 Romain Perier
# Released under the MIT license (see COPYING.MIT for the terms)

#@TYPE: Machine
#@NAME: Firefly RK3288
#@DESCRIPTION: Firefly-RK3288 is a high-performance platform, with strong computing power, graphic processing and video decoding ability.
#http://www.t-firefly.com/en/

require conf/machine/include/rk3288.inc

KERNEL_DEVICETREE = "rk3288-firefly.dtb"
UBOOT_MACHINE = "firefly-rk3288_defconfig"

WKS_FILE ?= "firefly-rk3288.wks"
IMAGE_FSTYPES += "wic wic.bmap"

WKS_FILE_DEPENDS ?= " \
    mtools-native \
    dosfstools-native \
    virtual/bootloader \
    virtual/kernel \
    "
IMAGE_BOOT_FILES ?= "\
    ${KERNEL_IMAGETYPE} \
    ${KERNEL_DEVICETREE} \
    "
```

## meta-rockchip/conf/machine/include/rk3188.inc
```bitbake
# Copyright (C) 2015 Romain Perier
# Released under the MIT license (see COPYING.MIT for the terms)

SOC_FAMILY  = "rk3188"

require conf/machine/include/tune-cortexa9.inc
require conf/machine/include/soc-family.inc
require conf/machine/include/rockchip-defaults.inc

KBUILD_DEFCONFIG = "multi_v7_defconfig"
KERNEL_IMAGETYPE = "zImage"
```

## meta-rockchip/conf/machine/include/rk3288.inc
```bitbake
# Copyright (C) 2015 Romain Perier
# Released under the MIT license (see COPYING.MIT for the terms)

SOC_FAMILY = "rk3288"

require conf/machine/include/tune-cortexa17.inc
require conf/machine/include/soc-family.inc
require conf/machine/include/rockchip-defaults.inc

KBUILD_DEFCONFIG ?= "multi_v7_defconfig"
KERNEL_IMAGETYPE = "zImage"

SERIAL_CONSOLES = "115200;ttyS2"

PREFERRED_PROVIDER_virtual/bootloader ?= "u-boot"
SPL_BINARY ?= "idbloader.img"
```

## meta-rockchip/conf/machine/include/rk3399.inc
```bitbake
# Copyright (C) 2020 Garmin Ltd. or its subsidaries
# Released under the MIT license (see COPYING.MIT for the terms)

SOC_FAMILY = "rk3399"

DEFAULTTUNE ?= "cortexa72-cortexa53-crypto"

require conf/machine/include/tune-cortexa72-cortexa53.inc
require conf/machine/include/soc-family.inc
require conf/machine/include/rockchip-defaults.inc

KBUILD_DEFCONFIG ?= "defconfig"
KERNEL_CLASSES = "kernel-fitimage"
KERNEL_IMAGETYPE = "fitImage"

ATF_PLATFORM ?= "rk3399"
ATF_TARGET ?= "bl31"
ATF_SUFFIX ?= "elf"

UBOOT_SUFFIX ?= "itb"
UBOOT_ENTRYPOINT ?= "0x06000000"

SERIAL_CONSOLES = "115200;ttyS2"

PREFERRED_PROVIDER_virtual/bootloader ?= "u-boot"
SPL_BINARY ?= "idbloader.img"
```

## meta-rockchip/conf/machine/include/rockchip-defaults.inc
```bitbake
# meta-rockchip default settings

# kernel
PREFERRED_PROVIDER_virtual/kernel ?= "linux-yocto"
KCONFIG_MODE ?= "alldefconfig"
LINUX_VERSION_EXTENSION ?= "-rockchip"

# xserver
PREFERRED_PROVIDER_virtual/xserver = "xserver-xorg"
XSERVER = " \
	xserver-xorg \
	xserver-xorg-utils \
	xserver-xorg-xvfb \
	xserver-xorg-extension-glx \
	xserver-xorg-module-libwfb \
	xserver-xorg-module-exa \
	xf86-video-modesetting \
	xf86-input-evdev \
	xf86-input-mouse \
	xf86-input-keyboard \
	"

# misc
IMAGE_FSTYPES += "ext4"

# boot device (sd-card/emmc)
RK_BOOT_DEVICE ??= "mmcblk0"
WICVARS_append = " RK_BOOT_DEVICE"
```

## meta-rockchip/conf/machine/rock-pi-4.conf
```bitbake
# Copyright (C) 2020 Garmin Ltd. or its subsidaries
# Released under the MIT license (see COPYING.MIT for the terms)

#@TYPE: Machine
#@NAME: Rock Pi 4 RK3399
#@DESCRIPTION: Rock Pi 4 is a Raspberry Pi 4 Alternative based on Rockchip RK3399 Processor.

require conf/machine/include/rk3399.inc

KERNEL_DEVICETREE = "rockchip/rk3399-rock-pi-4.dtb"
UBOOT_MACHINE = "rock-pi-4-rk3399_defconfig"

RK_BOOT_DEVICE = "mmcblk1"
WKS_FILE ?= "rock-pi-4.wks"
IMAGE_FSTYPES += "wic wic.bmap"

WKS_FILE_DEPENDS ?= " \
    mtools-native \
    dosfstools-native \
    virtual/bootloader \
    virtual/kernel \
    "
IMAGE_BOOT_FILES ?= "\
    ${KERNEL_IMAGETYPE} \
    "

SERIAL_CONSOLES = "1500000;ttyS2"

MACHINE_EXTRA_RRECOMMENDS += "kernel-modules"
```

## meta-rockchip/conf/machine/rock2-square.conf
```bitbake
# Copyright (C) 2016 Romain Perier
# Released under the MIT license (see COPYING.MIT for the terms)

#@TYPE: Machine
#@NAME: Rock2 Square
#@DESCRIPTION: Radxa Rock2 is a series of the second single board computer from Radxa. This is the square baseboard.
#http://radxa.com/Rock2

require conf/machine/include/rk3288.inc

SPL_BINARY = "u-boot-spl-dtb.bin"
KERNEL_DEVICETREE = "rk3288-rock2-square.dtb"
UBOOT_MACHINE = "rock2_defconfig"

# This board doesn't support the combined idbloader, so resort to the older
# image class
IMAGE_FSTYPES += "rockchip-gpt-img"
IMAGE_CLASSES += "rockchip-gpt-img"
```
