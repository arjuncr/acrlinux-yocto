## build/conf/bblayers.conf
```bitbake
# POKY_BBLAYERS_CONF_VERSION is increased each time build/conf/bblayers.conf
# changes incompatibly
POKY_BBLAYERS_CONF_VERSION = "2"

BBPATH = "${TOPDIR}"
BBFILES ?= ""

BBLAYERS ?= " \
  /home/arjuncr/acrlinux/acrlinux-yocto/meta \
  /home/arjuncr/acrlinux/acrlinux-yocto/meta-poky \
  /home/arjuncr/acrlinux/acrlinux-yocto/meta-yocto-bsp \
  "
```

## meta-acrlinux/conf/bblayers.conf.sample
```bitbake
# changes incompatibly
ACRLINUX_BBLAYERS_CONF_VERSION = "2"

BBPATH = "${TOPDIR}"
BBFILES ?= ""

BBLAYERS ?= " \
  ##OEROOT##/meta \
  ##OEROOT##/meta-acrlinux \
  ##OEROOT##/meta-yocto-bsp \
  "
```

## meta-acrlinux/conf/distro/acrlinux.conf
```bitbake
DISTRO = "acrlinux"
DISTRO_NAME = "Acrlinux disto"
DISTRO_VERSION = "1.0.0"
DISTRO_CODENAME = "hardknott"
SDK_VENDOR = "-acrlinuxsdk"
SDK_VERSION = "${@d.getVar('DISTRO_VERSION').replace('snapshot-${METADATA_REVISION}', 'snapshot')}"
SDK_VERSION[vardepvalue] = "${SDK_VERSION}"

MAINTAINER = "acrlinux <acrlinux.com>"

TARGET_VENDOR = "-acrlinux"

LOCALCONF_VERSION = "1"

# Override these in acrlinux based distros
ACRLINUX_DEFAULT_DISTRO_FEATURES = "largefile opengl ptest multiarch wayland vulkan"
ACRLINUX_DEFAULT_EXTRA_RDEPENDS = "packagegroup-core-boot"
ACRLINUX_DEFAULT_EXTRA_RRECOMMENDS = "kernel-module-af-packet"

DISTRO_FEATURES ?= "${DISTRO_FEATURES_DEFAULT} ${ACRLINUX_DEFAULT_DISTRO_FEATURES}"

PREFERRED_VERSION_linux-acrlinux ?= "5.10%"

SDK_NAME = "${DISTRO}-${TCLIBC}-${SDKMACHINE}-${IMAGE_BASENAME}-${TUNE_PKGARCH}-${MACHINE}"
SDKPATH = "/opt/${DISTRO}/${SDK_VERSION}"

DISTRO_EXTRA_RDEPENDS += "${ACRLINUX_DEFAULT_EXTRA_RDEPENDS}"
DISTRO_EXTRA_RRECOMMENDS += "${ACRLINUX_DEFAULT_EXTRA_RRECOMMENDS}"

TCLIBCAPPEND = ""

PREMIRRORS ??= "\
bzr://.*/.*   http://downloads.yoctoproject.org/mirror/sources/ \n \
cvs://.*/.*   http://downloads.yoctoproject.org/mirror/sources/ \n \
git://.*/.*   http://downloads.yoctoproject.org/mirror/sources/ \n \
gitsm://.*/.* http://downloads.yoctoproject.org/mirror/sources/ \n \
hg://.*/.*    http://downloads.yoctoproject.org/mirror/sources/ \n \
osc://.*/.*   http://downloads.yoctoproject.org/mirror/sources/ \n \
p4://.*/.*    http://downloads.yoctoproject.org/mirror/sources/ \n \
svn://.*/.*   http://downloads.yoctoproject.org/mirror/sources/ \n"

SANITY_TESTED_DISTROS ?= " \
            poky-3.2 \n \
            poky-3.3 \n \
            ubuntu-16.04 \n \
            ubuntu-18.04 \n \
            ubuntu-20.04 \n \
            fedora-31 \n \
            fedora-32 \n \
            fedora-33 \n \
            centos-7 \n \
            centos-8 \n \
            debian-8 \n \
            debian-9 \n \
            debian-10 \n \
            opensuseleap-15.1 \n \
            opensuseleap-15.2 \n \
            "

INHERIT += "reproducible_build"

BB_SIGNATURE_HANDLER ?= "OEEquivHash"
BB_HASHSERVE ??= "auto"
```

## meta-acrlinux/conf/layer.conf
```bitbake
# We have a conf and classes directory, add to BBPATH
BBPATH .= ":${LAYERDIR}"

# We have recipes-* directories, add to BBFILES
BBFILES += "${LAYERDIR}/recipes-*/*/*.bb \
            ${LAYERDIR}/recipes-*/*/*.bbappend"

# cause compatibility issues with other layers
LAYERVERSION_meta-acrlinux = "6"
LAYERSERIES_COMPAT_meta-acrlinux = "zeus dunfell"
```

## meta-amd/meta-amd-bsp/conf/machine/e3000.conf
```bitbake
#@TYPE: Machine
#@NAME: e3000

#@DESCRIPTION: Machine configuration for e3000 systems

require conf/machine/include/amdx86.inc

# Setup a getty on all serial ports
SERIAL_CONSOLES = "115200;ttyS4 115200;ttyS5"

# Enable the kernel console on ttyS4/COM0
KERNEL_SERIAL_CONSOLE ?= "console=ttyS4,115200n8"

# Add machine specific AMD features and feature pkgs here
EXTRA_IMAGE_FEATURES += "amd-feature-networking"
DPDK_PKGS = "${@bb.utils.contains("BBFILE_COLLECTIONS", "dpdk", "dpdk dpdk-examples dpdk-test", "", d)}"
```

## meta-amd/meta-amd-bsp/conf/machine/include/amdx86.inc
```bitbake
PREFERRED_PROVIDER_virtual/kernel ?= "${@bb.utils.contains('RT_KERNEL_AMD', 'yes', "linux-yocto-rt", "linux-yocto", d)}"
PREFERRED_VERSION_linux-yocto ?= "5.4%"
PREFERRED_VERSION_linux-yocto-rt ?= "5.4%"

require conf/machine/include/tune-amdx86.inc
require conf/machine/include/amd-common-configurations.inc
include conf/machine/include/amd-customer-configurations.inc

MACHINE_FEATURES_remove = "alsa"
MACHINE_EXTRA_RRECOMMENDS_remove = " rtc-test alsa-utils"

# Disable the graphical console, no graphics support for now
# this allows the serial console to be used for installation
APPEND_remove="console=tty0"

# Drop features we do not need
DISTRO_FEATURES_remove="opengl x11 alsa pulseaudio"

MACHINEOVERRIDES =. "amd:amdx86:"

# Mask out recipes for packages we do not support for
# amdx86 but may be required by others. Use '|' sign
# between the patterns.
BBMASK = "\
.*/meta-amd/common/recipes-support/libtinyxml\
"
```

## meta-amd/meta-amd-bsp/conf/machine/include/tune-amdx86.inc
```bitbake
DEFAULTTUNE ?= "dbfp5"

require conf/machine/include/x86/arch-x86.inc
require conf/machine/include/x86-base.inc
# AMD DB-FP5 64bit (amdx86)
TUNEVALID[dbfp5] = "Enable AMD DB-FP5 (64 bit) specific processor optimizations"
TUNECONFLICTS[dbfp5] = "m32 mx32"
TUNE_CCARGS .= "${@bb.utils.contains("TUNE_FEATURES", "dbfp5", " -march=znver1", "", d)}"

# Extra tune selections
AVAILTUNES += "dbfp5"
TUNE_FEATURES_tune-dbfp5 = "m64 dbfp5"
BASE_LIB_tune-dbfp5 = "lib64"
TUNE_PKGARCH_tune-dbfp5 = "dbfp5"
PACKAGE_EXTRA_ARCHS_tune-dbfp5 = "${TUNE_PKGARCH_tune-dbfp5}"
```

## meta-amd/meta-amd-bsp/conf/machine/rome.conf
```bitbake
#@TYPE: Machine
#@NAME: rome

#@DESCRIPTION: Machine configuration for rome systems

require conf/machine/include/amdx86.inc

# Setup a getty on all serial ports
SERIAL_CONSOLES = "115200;ttyS0"

# Enable the kernel console on ttyS0/COM0
KERNEL_SERIAL_CONSOLE ?= "console=ttyS0,115200n8"
```

## meta-amd/meta-seattle/conf/layer.conf
```bitbake
BBPATH .= ":${LAYERDIR}"

BBFILES += "${LAYERDIR}/recipes-*/*/*.bb*"

BBFILE_COLLECTIONS += "seattle"
BBFILE_PATTERN_seattle := "^${LAYERDIR}/"
BBFILE_PRIORITY_seattle = "14"

LAYERDEPENDS_seattle = "amd-bsp core"
```

## meta-amd/meta-seattle/conf/machine/seattle-be.conf
```bitbake
DEFAULTTUNE ?= "aarch64_be"
TRANSLATED_TARGET_ARCH = "aarch64-be"

require conf/machine/seattle.inc

PREFERRED_VERSION_linux-seattle = "3.19%"
```

## meta-amd/meta-seattle/conf/machine/seattle.conf
```bitbake
DEFAULTTUNE ?= "aarch64"

require conf/machine/seattle.inc

PREFERRED_VERSION_linux-seattle = "4.1%"
```

## meta-amd/meta-seattle/conf/machine/seattle.inc
```bitbake
#@TYPE: Machine
#@NAME: AMD Seattle
#@DESCRIPTION: ARMv8 Cortex-A57

require conf/machine/include/arm/arch-armv8.inc

PREFERRED_PROVIDER_virtual/kernel ?= "linux-seattle"

MACHINE_FEATURES = "pci ext2 ext3 serial"

RDEPENDS_kernel-base = "kernel-image"

KERNEL_IMAGETYPE = "Image"

SERIAL_CONSOLES = "115200;ttyAMA0"

IMAGE_FSTYPES += "ext2.gz tar.gz"

# we do not want to have getty running since  we do not have a
# graphical display attached and therefore do not need virtual
# terminal functionality
USE_VT = "0"
```

## meta-cloud-services/meta-openstack-aio-deploy/conf/layer.conf
```bitbake
# We have a conf and classes directory, append to BBPATH
BBPATH .= ":${LAYERDIR}"

# We have a recipes directory, add to BBFILES
BBFILES += "${LAYERDIR}/recipes*/*/*.bb ${LAYERDIR}/recipes*/*/*.bbappend"

BBFILE_COLLECTIONS += "openstack-aio-deploy-layer"
BBFILE_PATTERN_openstack-aio-deploy-layer := "^${LAYERDIR}/"
BBFILE_PRIORITY_openstack-aio-deploy-layer = "6"
LAYERSERIES_COMPAT_openstack-aio-deploy-layer = "thud warrior"

LAYERDEPENDS_openstack-aio-deploy-layer = " \
	core \
	cloud-services-layer \
	openembedded-layer \
	networking-layer \
        virtualization-layer \
	openstack-layer \
	"
```

## meta-cloud-services/meta-openstack-compute-deploy/conf/layer.conf
```bitbake
# We have a conf and classes directory, append to BBPATH
BBPATH .= ":${LAYERDIR}"

# We have a recipes directory, add to BBFILES
BBFILES += "${LAYERDIR}/recipes*/*/*.bb ${LAYERDIR}/recipes*/*/*.bbappend"

BBFILE_COLLECTIONS += "openstack-compute-deploy-layer"
BBFILE_PATTERN_openstack-compute-deploy-layer := "^${LAYERDIR}/"
BBFILE_PRIORITY_openstack-compute-deploy-layer = "6"
LAYERSERIES_COMPAT_openstack-compute-deploy-layer = "thud warrior"

LAYERDEPENDS_openstack-compute-deploy-layer = " \
	core \
	cloud-services-layer \
	openembedded-layer \
	networking-layer \
	virtualization-layer \
	openstack-layer \
	"
```

## meta-cloud-services/meta-openstack-controller-deploy/conf/layer.conf
```bitbake
# We have a conf and classes directory, append to BBPATH
BBPATH .= ":${LAYERDIR}"

# We have a recipes directory, add to BBFILES
BBFILES += "${LAYERDIR}/recipes*/*/*.bb ${LAYERDIR}/recipes*/*/*.bbappend"

BBFILE_COLLECTIONS += "openstack-controller-deploy-layer"
BBFILE_PATTERN_openstack-controller-deploy-layer := "^${LAYERDIR}/"
BBFILE_PRIORITY_openstack-controller-deploy-layer = "6"
LAYERSERIES_COMPAT_openstack-controller-deploy-layer = "thud warrior"

LAYERDEPENDS_openstack-controller-deploy-layer = " \
	core \
	cloud-services-layer \
	openembedded-layer \
	networking-layer \
	virtualization-layer \
	openstack-layer \
"
```
